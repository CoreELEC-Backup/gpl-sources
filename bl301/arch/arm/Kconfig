## bl301/arch/arm/Kconfig
```kconfig
menu "ARM architecture"
	depends on ARM

config SYS_ARCH
	default "arm"

config ARM64
	bool

config HAS_VBAR
        bool

config SYS_CPU
	default "armv8" if ARM64

choice
	prompt "Target select"

config TARGET_MESON_GX
	bool "Support meson gx-series 64bit"
	select ARM64

config TARGET_MESON_G12B
	bool "Support meson g12b-series 64bit"
	select ARM64

endchoice

source "board/Kconfig"

source "arch/arm/Kconfig.debug"

endmenu
```

## bl301/board/Kconfig
```kconfig
config GENERIC_GX
	bool "Support Generic gxl board"
	default n

config GENERIC_P241_P281
	bool "Support Generic gxl p241/p281 board"
	default n

config GENERIC_G12B
	bool "Support Generic g12b board"
	default n

config GENERIC_SM1
	bool "Support Generic sm1 board"
	default n

config KHADAS_VIM1
	bool "Support Khadas VIM1 board"
	select KHADAS_COMMON
	default n

config KHADAS_VIM3
	bool "Support Khadas VIM3 board"
	default n

config KHADAS_VIM3L
	bool "Support Khadas VIM3L board"
	default n

if GENERIC_GX
source "board/generic/gxl/Kconfig"
endif

if GENERIC_P241_P281
source "board/generic/gxl_p241_p281/Kconfig"
endif

if GENERIC_G12B
source "board/generic/g12b/Kconfig"

config SYS_CONFIG_NAME
	default "generic_g12b"
endif

if GENERIC_SM1
source "board/generic/g12b/Kconfig"

config SYS_CONFIG_NAME
	default "generic_sm1"
endif

if KHADAS_VIM1
source "board/khadas/kvim1/Kconfig"
endif

if KHADAS_VIM3
source "board/khadas/kvim3/Kconfig"

config SYS_CONFIG_NAME
	default "kvim3"
endif

if KHADAS_VIM3L
source "board/khadas/kvim3/Kconfig"

config SYS_CONFIG_NAME
	default "kvim3l"
endif
```

## bl301/board/generic/g12b/Kconfig
```kconfig
config SYS_CPU
	string
	default "armv8"

config SYS_BOARD
	string
	default "g12b"

config SYS_VENDOR
	string
	default "generic"

config SYS_SOC
	string
	default "g12b"
```

## bl301/board/generic/gxl/Kconfig
```kconfig
if TARGET_MESON_GX

config SYS_CPU
	string
	default "armv8"

config SYS_BOARD
	string
	default "gxl"

config SYS_VENDOR
	string
	default "generic"

config SYS_SOC
	string
	default "gxl"

config SYS_CONFIG_NAME
	default "generic_gxl"

endif
```

## bl301/board/khadas/kvim3/Kconfig
```kconfig
config SYS_CPU
	string
	default "armv8"

config SYS_BOARD
	string
	default "kvim3"

config SYS_VENDOR
	string
	default "khadas"

config SYS_SOC
	string
	default "g12b"
```

## bl301/configs/Generic_21_defconfig
```kconfig
CONFIG_ARM=y
CONFIG_TARGET_MESON_GX=y
CONFIG_GENERIC_GX=y
CONFIG_DM=y
CONFIG_DM_GPIO=y
```

## bl301/configs/Generic_21_p241_p281_defconfig
```kconfig
CONFIG_ARM=y
CONFIG_TARGET_MESON_GX=y
CONFIG_GENERIC_P241_P281=y
CONFIG_DM=y
CONFIG_DM_GPIO=y
```

## bl301/configs/Generic_28_29_defconfig
```kconfig
CONFIG_ARM=y
CONFIG_TARGET_MESON_G12B=y
CONFIG_GENERIC_G12B=y
CONFIG_DM=y
CONFIG_DM_GPIO=y
```

## bl301/configs/Generic_2b_defconfig
```kconfig
CONFIG_ARM=y
CONFIG_TARGET_MESON_G12B=y
CONFIG_GENERIC_SM1=y
CONFIG_DM=y
CONFIG_DM_GPIO=y
```

## bl301/configs/Khadas_VIM1_21_defconfig
```kconfig
CONFIG_ARM=y
CONFIG_TARGET_MESON_GX=y
CONFIG_KHADAS_VIM1=y
CONFIG_DM=y
CONFIG_DM_GPIO=y
```

## bl301/configs/Khadas_VIM3_29_defconfig
```kconfig
CONFIG_ARM=y
CONFIG_TARGET_MESON_G12B=y
CONFIG_KHADAS_VIM3=y
CONFIG_DM=y
CONFIG_DM_GPIO=y
```

## media_tree_aml/drivers/media/platform/meson/video_dev/Kconfig
```kconfig
menu "V4L2 Video Support"

config V4L_AMLOGIC_VIDEO
	tristate "Amlogic v4l video device support"
	select VIDEO_DEV
	select VIDEO_V4L2
	select VIDEOBUF_GEN
	select VIDEOBUF_RESOURCE
	default n
	---help---
	  Select to enable "Amlogic v4l video device support.


endmenu
```

## media_tree_cc/drivers/media/pci/tbsecp3/Kconfig
```kconfig
config DVB_TBSECP3
	tristate "TBS ECP3 FPGA based cards"
	depends on DVB_CORE && PCI && I2C
	select I2C_ALGOBIT
	select DVB_TAS2101 if MEDIA_SUBDRV_AUTOSELECT
	select MEDIA_TUNER_AV201X if MEDIA_SUBDRV_AUTOSELECT
	select DVB_STV091X if MEDIA_SUBDRV_AUTOSELECT
	select MEDIA_TUNER_STV6120 if MEDIA_SUBDRV_AUTOSELECT
	select DVB_SI2168 if MEDIA_SUBDRV_AUTOSELECT
	select MEDIA_TUNER_SI2157 if MEDIA_SUBDRV_AUTOSELECT
	select DVB_MXL58X if MEDIA_SUBDRV_AUTOSELECT
	select DVB_SI2183 if MEDIA_SUBDRV_AUTOSELECT
	select DVB_STID135 if MEDIA_SUBDRV_AUTOSELECT
	help
	  Support for cards with TBS ECP3 FPGA based PCIe bridge.

	  Say Y or M if you own such a device and want to use it.
	  If unsure say N.
```
